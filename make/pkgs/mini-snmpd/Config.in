## make/pkgs/mini-snmpd/Config.in
```kconfig
config FREETZ_PACKAGE_MINI_SNMPD
	bool "mini-snmpd 2.0 (binary only)"
	depends on !(FREETZ_TARGET_UCLIBC_0_9_28 || FREETZ_TARGET_UCLIBC_0_9_29)
	depends on FREETZ_KERNEL_VERSION_2_6_32_MIN
	select FREETZ_LIB_libconfuse
	default n
	help
		This program is an SNMP server for "embedded systems".
		The advantage in comparison to other products is the
		low usage of system resources.
```
